#include "lcd5110.h"
#include "spi.h"
#include "delay.h"
#include "stdio.h"
#include "stdarg.h"

static u8 lcd_buf[84*6];

const unsigned char  Font6x8[][6] =
{
  { 0x00, 0x00, 0x00, 0x00, 0x00, 0x00 },   // sp
	{ 0x00, 0x00, 0x00, 0x2f, 0x00, 0x00 },   // !
	{ 0x00, 0x00, 0x07, 0x00, 0x07, 0x00 },   // "
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	{ 0x14, 0x14, 0x14, 0x14, 0x14, 0x14 }    // horiz lines
};

#if EN_SPI2_DMA
DMA_InitTypeDef DMA_initstructure ;
void DMA_SPI_Config(void)
{  
		
   // 初始化DMA 结构体
    DMA_initstructure.DMA_BufferSize = 0 ;
    DMA_initstructure.DMA_DIR = DMA_DIR_PeripheralDST ;
    DMA_initstructure.DMA_M2M = DISABLE ;
    DMA_initstructure.DMA_MemoryBaseAddr = (u32)lcd_buf;
    DMA_initstructure.DMA_MemoryDataSize = DMA_MemoryDataSize_Byte ;
    DMA_initstructure.DMA_MemoryInc = DMA_MemoryInc_Enable ;
    DMA_initstructure.DMA_Mode = DMA_Mode_Normal;
    //spi2 data rigester address 
    DMA_initstructure.DMA_PeripheralBaseAddr = (u32)&SPI2->DR ;
    DMA_initstructure.DMA_PeripheralDataSize = DMA_PeripheralDataSize_Byte ;
    DMA_initstructure.DMA_PeripheralInc = DMA_PeripheralInc_Disable;
    DMA_initstructure.DMA_Priority = DMA_Priority_High ;  
}
#endif

void LCD_GPIO_Init(void)
{
	//LCD_DC			--------> PB12
	//LCD_RST			--------> PB3
	//LCD_CE			--------> PA15
	GPIO_InitTypeDef GPIO_InitStructure;
	RCC_APB2PeriphClockCmd(RCC_APB2Periph_GPIOA|RCC_APB2Periph_GPIOB | RCC_APB2Periph_AFIO, ENABLE);
	GPIO_InitStructure.GPIO_Pin = GPIO_Pin_12 | GPIO_Pin_3;
 	GPIO_InitStructure.GPIO_Speed = GPIO_Speed_50MHz;
 	GPIO_InitStructure.GPIO_Mode = GPIO_Mode_Out_PP;
 	GPIO_Init(GPIOB, &GPIO_InitStructure);
	
	GPIO_InitStructure.GPIO_Pin = GPIO_Pin_15;
 	GPIO_InitStructure.GPIO_Speed = GPIO_Speed_50MHz;
 	GPIO_InitStructure.GPIO_Mode = GPIO_Mode_Out_PP;
 	GPIO_Init(GPIOA, &GPIO_InitStructure);
	LCD_CE = 1;
}

void LCD5110_Init(void)
{
//	RCC_APB1PeriphClockCmd(RCC_APB1Periph_SPI2, ENABLE);
#if EN_SPI2_DMA
	RCC_AHBPeriphClockCmd(RCC_AHBPeriph_DMA1 , ENABLE);
#endif
	SPI2_Init();
#if EN_SPI2_DMA
	DMA_SPI_Config();
#endif
	LCD_RST = 0;
	delay_ms(1);
	LCD_RST = 1;
	LCD_CE = 1;
	delay_ms(1);
	LCD_CE = 0;
	//设置LCD
	LCD_Send(0x21, DC_CMD);	//使用扩展命令设置LCD模式
	LCD_Send(0xC8, DC_CMD);	//设置偏置电压
	LCD_Send(0x06, DC_CMD);	//温度校正
	LCD_Send(0x13, DC_CMD); //1:48
	LCD_Send(0x20, DC_CMD);	//使用基本命令
	
	LCD_Send(0x0C, DC_CMD); //设定显示模式，普通显示
	//LCD_Send(0x0D, DC_CMD);	//设定显示模式，反转显示
	LCD_Clear();
	LCD_CE = 1;
}

/*******************************************************************************
* Function Name  : LCD_Send
* Description    : 向LCD发送数据
* Input          : u8 data, DCType dc
* Output         : None
* Return         : None
*******************************************************************************/
void LCD_Send(u8 data, DCType dc)
{
//	LCD_CE = 0;
//  while( SPI_I2S_GetFlagStatus(SPI2, SPI_I2S_FLAG_TXE ) == RESET );
	if (dc==DC_CMD)
		LCD_DC = 0;	//发送命令
	else
		LCD_DC = 1;//发送数据
	SPI2_ReadWriteByte(data);
//    SPI_I2S_SendData(SPI2, data);
//    //等待数据完成，否则LCD_SET_XY 会有问题
//    while( SPI_I2S_GetFlagStatus(SPI2, SPI_I2S_FLAG_TXE ) == RESET );
//	LCD_CE = 1;
}

/*******************************************************************************
* Function Name  : LCD_SetContrast
* Description    : 设置LCD对比度(对比度范围: 0~127)
* Input          : u8 contrast
* Output         : None
* Return         : None
*******************************************************************************/
void LCD_SetContrast(u8 contrast)
{
	LCD_CE = 0;
    LCD_Send(0x21, DC_CMD);
    LCD_Send(0x80 | contrast, DC_CMD);
    LCD_Send(0x20, DC_CMD);
	LCD_CE = 1;
}
/*******************************************************************************
* Function Name  : LCD_SetXY
* Description    : 设置LCD当前坐标
* Input          : u8 X, u8 Y	
* Output         : None
* Return         : None
*******************************************************************************/
void LCD_SetXY(u8 X, u8 Y)
{
	if (X>13) X = 13;
	if (Y>5) Y = 5;
	X *= 6;
	LCD_Send(0x80 | X, DC_CMD);    // 列 
	delay_ms(10);  
	LCD_Send(0x40 | Y, DC_CMD);    // 行
}
/*******************************************************************************
* Function Name  : LCD_Clear
* Description    : LCD清屏
* Input          : None	
* Output         : None
* Return         : None
*******************************************************************************/
void LCD_Clear(void)
{
	u16 i;
	LCD_CE = 0;
  LCD_Send(0x80, DC_CMD);
	delay_ms(1);
	LCD_Send(0x40, DC_CMD);
	for(i=0; i<504; i++)
	LCD_Send(0, DC_DATA);	  
	LCD_CE = 1;
}

/*******************************************************************************
* Function Name  : LCD_Write_Char
* Description    : 向LCD写一个英文字符
* Input          : u8 ascii
* Output         : None
* Return         : None
*******************************************************************************/
void LCD_Write_Char(u8 ascii)
{
    u8 n;
	LCD_CE = 0;
    ascii -= 32; //ASCII码-32
    for (n=0; n<6; n++)
		LCD_Send(Font6x8[ascii][n], DC_DATA);
	LCD_CE = 1;
}

/*******************************************************************************
* Function Name  : LCD_Write_EnStr
* Description    : 向LCD写英文字符串
* Input          : u8 ascii
* Output         : None
* Return         : None
*******************************************************************************/
void LCD_Write_EnStr(u8 X, u8 Y, u8* s)
{
	
    u8 * str = s;
    int i = 0;
    int lcd_index =0;
    if(str == 0 )
    {
        return ;
    }
		LCD_CE = 0;
#if EN_SPI2_DMA
    //等待上次DMA请求结束
    while(DMA_GetCurrDataCounter(DMA1_Channel5)) ;  
#endif
    LCD_SetXY(X,Y);
    while(*str)
    {
        //拷贝显示数据到缓冲区
        for(i=0;i<6;i++)
        {
            lcd_buf[lcd_index ++ ] = Font6x8[*str - 32][i];
        }
					//memcpy(lcd_buf+6*str,&Font6x8[*str - 32][0],6);	
        str ++ ;
    }
    lcd_buf[lcd_index ++ ] = 0 ; // lcd_index ++ 多发送一个0否者最后一个字符会缺少一个像素
#if EN_SPI2_DMA
    DMA_initstructure.DMA_BufferSize = lcd_index ;
   
    DMA_Cmd(DMA1_Channel5, DISABLE); 
    DMA_Init( DMA1_Channel5, &DMA_initstructure) ;
    DMA_Cmd(DMA1_Channel5, ENABLE);
    LCD_DC = 1;  
    SPI_I2S_DMACmd( SPI2, SPI_I2S_DMAReq_Tx, ENABLE) ;
    #else
    for(i = 0 ;i<lcd_index ;i++)
    {
        LCD_Send(lcd_buf[i], DC_DATA);
    }
    #endif
		LCD_CE = 1;
}

void LCD_Printf(u8 x,u8 y,const char *fmt,...)
{
		va_list ap;  
		char string[1024];//
		va_start(ap,fmt);  
		vsprintf(string,fmt,ap); 
		LCD_Write_EnStr(x,y,(u8*)string);
		va_end(ap);  
}
